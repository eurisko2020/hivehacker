## dashcam/configs/raspberrypicm4io_64_clean_dashcam_defconfig
```kconfig
# Custom Clean Dashcam defconfig - based on raspberrypicm4io_64_dev_dashcam_defconfig
# Removes: Hivemapper app layer, token mining, ODC API, TFLite object detection,
#          LoRaWAN, camera-bridge (JPEG pipeline), folder-purger, P2P Wi-Fi
# Adds: dashcamd (H.264 recording daemon), dashcam-webui, dropbear (lightweight SSH),
#       nginx, additional kernel configs for V4L2 hardware encoder

BR2_aarch64=y
BR2_cortex_a72=y
BR2_ARM_FPU_VFPV4=y
BR2_CCACHE=y
BR2_CCACHE_DIR="$(TOPDIR)/../.buildroot-ccache"
BR2_TOOLCHAIN_EXTERNAL=y
BR2_TOOLCHAIN_EXTERNAL_BOOTLIN=y
BR2_TOOLCHAIN_EXTERNAL_BOOTLIN_AARCH64_GLIBC_STABLE=y
BR2_TARGET_GENERIC_HOSTNAME="dashcam"
BR2_TARGET_GENERIC_ISSUE="Welcome to Clean Dashcam"
BR2_INIT_SYSTEMD=y
# BR2_TARGET_GENERIC_GETTY is not set
# BR2_TARGET_GENERIC_REMOUNT_ROOTFS_RW is not set
BR2_SYSTEM_DHCP="eth0"
BR2_SYSTEM_DEFAULT_PATH="/bin:/sbin:/usr/bin:/usr/sbin"
BR2_ROOTFS_USERS_TABLES="$(BR2_EXTERNAL_DASHCAM_PATH)/board/raspberrypicm4io_64_dev/users"
BR2_ROOTFS_OVERLAY="$(BR2_EXTERNAL_DASHCAM_PATH)/board/raspberrypicm4io_64_dev/overlays/common $(BR2_EXTERNAL_DASHCAM_PATH)/board/raspberrypicm4io_64_clean/overlays/common"
BR2_ROOTFS_POST_BUILD_SCRIPT="$(BR2_EXTERNAL_DASHCAM_PATH)/board/raspberrypicm4io_64_clean/post_build.sh"
BR2_ROOTFS_POST_FAKEROOT_SCRIPT="$(BR2_EXTERNAL_DASHCAM_PATH)/board/raspberrypicm4io_64_dev/fakeroot.sh"
BR2_ROOTFS_POST_IMAGE_SCRIPT="$(BR2_EXTERNAL_DASHCAM_PATH)/board/raspberrypicm4io_64_dev/post_image.sh"

# Linux Kernel
BR2_LINUX_KERNEL=y
BR2_LINUX_KERNEL_CUSTOM_TARBALL=y
BR2_LINUX_KERNEL_CUSTOM_TARBALL_LOCATION="$(call github,raspberrypi,linux,581049d718caf95f5feb00607ac748d5841cf27c)/linux-581049d718caf95f5feb00607ac748d5841cf27c.tar.gz"
BR2_LINUX_KERNEL_DEFCONFIG="bcm2711"
BR2_LINUX_KERNEL_CONFIG_FRAGMENT_FILES="$(BR2_EXTERNAL_DASHCAM_PATH)/board/raspberrypicm4io_64_clean/linux.fragment"
BR2_LINUX_KERNEL_NEEDS_HOST_OPENSSL=y

# Core packages
BR2_PACKAGE_BUSYBOX_INDIVIDUAL_BINARIES=y
BR2_PACKAGE_FFMPEG=y
BR2_PACKAGE_JQ=y
BR2_PACKAGE_E2FSPROGS=y
BR2_PACKAGE_E2FSPROGS_RESIZE2FS=y
BR2_PACKAGE_MMC_UTILS=y
BR2_PACKAGE_NTFS_3G=y
BR2_PACKAGE_BRCMFMAC_SDIO_FIRMWARE_RPI=y
BR2_PACKAGE_BRCMFMAC_SDIO_FIRMWARE_RPI_WIFI=y
BR2_PACKAGE_RPI_FIRMWARE=y
BR2_PACKAGE_RPI_FIRMWARE_VARIANT_PI4=y
BR2_PACKAGE_RPI_FIRMWARE_VARIANT_PI4_X=y
BR2_PACKAGE_RPI_FIRMWARE_VARIANT_PI4_DB=y
BR2_PACKAGE_RPI_FIRMWARE_CONFIG_FILE="$(BR2_EXTERNAL_DASHCAM_PATH)/board/raspberrypicm4io_64_dev/config.txt"
BR2_PACKAGE_MINICOM=y
BR2_PACKAGE_PARTED=y
BR2_PACKAGE_USBMOUNT=y

# Python for dashcamd and web UI
BR2_PACKAGE_PYTHON3=y
BR2_PACKAGE_PYTHON3_PYEXPAT=y
BR2_PACKAGE_PYTHON_SERIAL_ASYNCIO=y
BR2_PACKAGE_PYTHON_SMBUS_CFFI=y
BR2_PACKAGE_PYTHON_FLASK=y
BR2_PACKAGE_PYTHON_PYYAML=y
BR2_PACKAGE_PYTHON_PSUTIL=y

# Crypto / SSL
BR2_PACKAGE_LIBOPENSSL_BIN=y

# Hardware access
BR2_PACKAGE_LIBGPIOD=y
BR2_PACKAGE_LIBGPIOD_TOOLS=y
BR2_PACKAGE_I2C_TOOLS=y

# Camera - libcamera with V4L2 and apps (libcamera-vid)
BR2_PACKAGE_LIBCAMERA_V4L2=y
BR2_PACKAGE_LIBCAMERA_APPS=y
BR2_PACKAGE_LIBCAMERA_PIPELINE_RASPBERRYPI=y
BR2_PACKAGE_LIBYUV=y

# GPS support
BR2_PACKAGE_GPSD=y
BR2_PACKAGE_GPSD_CLIENTS=y

# Networking - Wi-Fi AP
BR2_PACKAGE_AVAHI=y
BR2_PACKAGE_AVAHI_DAEMON=y
BR2_PACKAGE_DHCPCD=y
BR2_PACKAGE_DNSMASQ=y
BR2_PACKAGE_HOSTAPD=y
BR2_PACKAGE_WIRELESS_TOOLS=y
BR2_PACKAGE_WPA_SUPPLICANT=y
BR2_PACKAGE_WPA_SUPPLICANT_AP_SUPPORT=y
BR2_PACKAGE_WPA_SUPPLICANT_CLI=y

# SSH - using dropbear for lighter weight (replacing OpenSSH)
BR2_PACKAGE_DROPBEAR=y

# Web server for Web UI
BR2_PACKAGE_NGINX=y

# System tools
BR2_PACKAGE_SUDO=y
BR2_PACKAGE_HTOP=y
BR2_PACKAGE_IOTOP=y

# Firmware update - keeping Rauc for A/B updates
BR2_PACKAGE_RAUC=y
BR2_PACKAGE_RAUC_DBUS=y
BR2_PACKAGE_RAUC_NETWORK=y
BR2_PACKAGE_RAUC_JSON=y

# Filesystem
BR2_TARGET_ROOTFS_SQUASHFS=y
# BR2_TARGET_ROOTFS_TAR is not set

# Bootloader
BR2_TARGET_UBOOT=y
BR2_TARGET_UBOOT_BOARD_DEFCONFIG="rpi_arm64"
BR2_TARGET_UBOOT_CONFIG_FRAGMENT_FILES="$(BR2_EXTERNAL_DASHCAM_PATH)/board/raspberrypicm4io_64_dev/uboot.fragment"
BR2_TARGET_UBOOT_NEEDS_OPENSSL=y

# Host tools for image creation
BR2_PACKAGE_HOST_DOSFSTOOLS=y
BR2_PACKAGE_HOST_E2FSPROGS=y
BR2_PACKAGE_HOST_GENIMAGE=y
BR2_PACKAGE_HOST_MTOOLS=y
BR2_PACKAGE_HOST_RASPBERRYPI_USBBOOT=y
BR2_PACKAGE_HOST_RAUC=y
BR2_PACKAGE_HOST_UBOOT_TOOLS=y
BR2_PACKAGE_HOST_UBOOT_TOOLS_ENVIMAGE=y
BR2_PACKAGE_HOST_UBOOT_TOOLS_ENVIMAGE_SIZE="0x4000"
BR2_PACKAGE_HOST_UBOOT_TOOLS_ENVIMAGE_REDUNDANT=y

# Custom dashcam packages (our new software)
BR2_PACKAGE_DASHCAMD=y
BR2_PACKAGE_DASHCAM_WEBUI=y

# REMOVED packages (present in stock, removed in clean build):
# BR2_PACKAGE_CAMERA_BRIDGE - replaced by dashcamd (H.264 hardware encoding)
# BR2_PACKAGE_FOLDER_PURGER - replaced by dashcamd storage manager
# BR2_PACKAGE_CAMERA_NODE - replaced by dashcamd camera worker
# BR2_PACKAGE_API_HEALTH_MANAGER - Hivemapper-specific, not needed
# BR2_PACKAGE_CAMERA_SCRIPTS - Hivemapper-specific, not needed
# BR2_PACKAGE_DATA_LOGGER - replaced by dashcamd GPS/IMU workers
# BR2_PACKAGE_LED_CONTROLLER - replaced by dashcamd LED worker
# BR2_PACKAGE_LORAWAN_LOGGER - LoRaWAN not present on all units, not needed
# BR2_PACKAGE_HDC_ACL - Hivemapper access control, not needed
# BR2_PACKAGE_ONBOARD_UPDATER - Hivemapper onboarding, not needed
# BR2_PACKAGE_YOLOV8 - object detection, Phase 2 candidate
# BR2_PACKAGE_OBJECT_DETECTION - object detection, Phase 2 candidate
# BR2_PACKAGE_USB_WRITE - replaced by dashcamd storage manager
# BR2_PACKAGE_LLDPD - network discovery, not needed for standalone
# BR2_PACKAGE_MJPG_STREAMER - replaced by dashcamd web UI live preview
# BR2_PACKAGE_OPENSSH - replaced by dropbear (lighter)
# BR2_PACKAGE_LIBFUSE - not needed
# BR2_PACKAGE_WEBP - not needed
# BR2_PACKAGE_FMT - not needed (dashcamd is Python-based)

# Added for dependency resolution
BR2_INSTALL_LIBSTDCPP=y
BR2_USE_WCHAR=y
BR2_PACKAGE_UTIL_LINUX=y
BR2_TOOLCHAIN_HEADERS_AT_LEAST_3_14=y
BR2_PACKAGE_UTIL_LINUX_SCHEDUTILS=y
BR2_PACKAGE_PERL=y
BR2_PACKAGE_PERL_IMAGE_EXIFTOOL=y
BR2_PACKAGE_LIBNICE=y
```

## dashcam/package/api-health-manager/Config.in
```kconfig
config BR2_PACKAGE_API_HEALTH_MANAGER
	bool "api-health-manager"
  select BR2_PACKAGE_NODEJS
```

## dashcam/package/dashcam-webui/Config.in
```kconfig
config BR2_PACKAGE_DASHCAM_WEBUI
	bool "dashcam-webui"
	select BR2_PACKAGE_PYTHON3
	select BR2_PACKAGE_PYTHON_FLASK
	select BR2_PACKAGE_NGINX
	help
	  Web UI for the clean dashcam firmware.
	  Provides file browser, live preview, settings, events log,
	  and system controls via a responsive web interface served
	  by nginx + Flask.
```

## dashcam/package/dashcamd/Config.in
```kconfig
config BR2_PACKAGE_DASHCAMD
	bool "dashcamd"
	select BR2_PACKAGE_PYTHON3
	select BR2_PACKAGE_PYTHON3_PYEXPAT
	select BR2_PACKAGE_PYTHON_SERIAL_ASYNCIO
	select BR2_PACKAGE_PYTHON_SMBUS_CFFI
	select BR2_PACKAGE_PYTHON_PYYAML
	select BR2_PACKAGE_PYTHON_PSUTIL
	select BR2_PACKAGE_LIBCAMERA
	select BR2_PACKAGE_LIBCAMERA_APPS
	select BR2_PACKAGE_LIBCAMERA_V4L2
	select BR2_PACKAGE_FFMPEG
	select BR2_PACKAGE_LIBGPIOD
	select BR2_PACKAGE_I2C_TOOLS
	help
	  The core dashcam recording daemon for the clean HDC dashcam firmware.
	  Replaces camera-bridge, folder-purger, camera-node, data-logger,
	  and led-controller with a single Python daemon that:
	  - Records H.264/HEVC video via libcamera-vid + V4L2 hardware encoder
	  - Manages loop recording with segment rotation and event locking
	  - Monitors G-sensor (IMU) for impact events
	  - Supports parking mode with motion-triggered recording
	  - Logs GPS/IMU telemetry as JSON sidecar metadata
	  - Controls LED status indicator via GPIO
```

## dashcam/package/folder_purger/Config.in
```kconfig
config BR2_PACKAGE_FOLDER_PURGER
	bool "folder_purger"
	help
	  General utility scripts
```

## dashcam/package/python-astunparse/Config.in
```kconfig
config BR2_PACKAGE_PYTHON_ASTUNPARSE
	bool "python-astunparse"
	select BR2_PACKAGE_PYTHON3
```

## dashcam/package/python-expecttest/Config.in
```kconfig
config BR2_PACKAGE_PYTHON_EXPECTTEST
	bool "python-expecttest"
	select BR2_PACKAGE_PYTHON3
```

## dashcam/package/python-gitpython/Config.in
```kconfig
config BR2_PACKAGE_PYTHON_GITPYTHON
	bool "python-gitpython"
	select BR2_PACKAGE_PYTHON_SIX # runtime
```

## dashcam/package/python-humanfriendly/Config.in
```kconfig
config BR2_PACKAGE_PYTHON_HUMANFRIENDLY
	bool "python-humanfriendly"
	select BR2_PACKAGE_PYTHON3
```

## dashcam/package/python-hypothesis/Config.in
```kconfig
config BR2_PACKAGE_PYTHON_HYPOTHESIS
	bool "python-hypothesis"
	select BR2_PACKAGE_PYTHON3
```

## dashcam/package/python-mpmath/Config.in
```kconfig
config BR2_PACKAGE_PYTHON_MPMATH
	bool "python-mpmath"
	select BR2_PACKAGE_PYTHON3
```

## dashcam/package/python-onnxruntime/Config.in
```kconfig
config BR2_PACKAGE_PYTHON_ONNXRUNTIME
	bool "python-onnxruntime"
	select BR2_PACKAGE_PYTHON3 # runtime
	select BR2_PACKAGE_PYTHON_PIP
```

## dashcam/package/python-opencv-python/Config.in
```kconfig
config BR2_PACKAGE_PYTHON_OPENCV_PYTHON
	bool "python-opencv-python"
	select BR2_PACKAGE_PYTHON3
	select BR2_PACKAGE_OPENCV4_LIB_PYTHON
	select BR2_PACKAGE_READLINE
	select BR2_PACKAGE_PYTHON_DISTRO
	select BR2_PACKAGE_PYTHON_SCIKIT_BUILD
	select BR2_PACKAGE_PYTHON_WHEEL
```

## dashcam/package/python-pandas/Config.in
```kconfig
config BR2_PACKAGE_PYTHON_PANDAS
	bool "python-pandas"
	select BR2_PACKAGE_PYTHON3 # runtime
```

## dashcam/package/python-pybind11/Config.in
```kconfig
config BR2_PACKAGE_PYTHON_PYBIND11
	bool "python-pybind11"
	select BR2_PACKAGE_PYTHON_SIX # runtime
```

## dashcam/package/python-scikit-build/Config.in
```kconfig
config BR2_PACKAGE_PYTHON_SCIKIT_BUILD
	bool "python-scikit-build"
	# select BR2_PACKAGE_PYTHON_SIX # runtime
	select BR2_PACKAGE_PYTHON3
```

## dashcam/package/python-scikit-build/Config.in.host
```kconfig
config BR2_PACKAGE_HOST_PYTHON_SCIKIT_BUILD
	bool "host python-scikit-build"
	# select BR2_PACKAGE_PYTHON_SIX # runtime
	select BR2_PACKAGE_PYTHON3
```

## dashcam/package/python-seaborn/Config.in
```kconfig
config BR2_PACKAGE_PYTHON_SEABORN
	bool "python-seaborn"
	select BR2_PACKAGE_PYTHON_SEABORN # runtime
```

## dashcam/package/python-sympy/Config.in
```kconfig
config BR2_PACKAGE_PYTHON_SYMPY
	bool "python-sympy"
	select BR2_PACKAGE_PYTHON3
```

## dashcam/package/python-thop/Config.in
```kconfig
config BR2_PACKAGE_PYTHON_THOP
	bool "python-thop"
	select BR2_PACKAGE_PYTHON_SIX # runtime
```

## dashcam/package/python-torch/Config.in
```kconfig
config BR2_PACKAGE_PYTHON_TORCH
	bool "python-torch"
	select BR2_PACKAGE_PYTHON3 # runtime
```

## dashcam/package/python-torchvision/Config.in
```kconfig
config BR2_PACKAGE_PYTHON_TORCHVISION
	bool "python-torchvision"
	select BR2_PACKAGE_PYTHON3 # runtime
	select BR2_PACKAGE_PYTHON_TORCH
```

## dashcam/package/python-types-dataclasses/Config.in
```kconfig
config BR2_PACKAGE_PYTHON_TYPES_DATACLASSES
	bool "python-types-dataclasses"
	select BR2_PACKAGE_PYTHON3
```

## dashcam/package/python-ultralytics/Config.in
```kconfig
config BR2_PACKAGE_PYTHON_ULTRALYTICS
	bool "python-ultralytics"
	select BR2_PACKAGE_PYTHON_SIX # runtime
```
