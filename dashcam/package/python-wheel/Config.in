## dashcam/package/python-wheel/Config.in
```kconfig
config BR2_PACKAGE_PYTHON_WHEEL
	bool "python-wheel"
	select BR2_PACKAGE_PYTHON_SIX # runtime
```

## dashcam/package/python-yappi/Config.in
```kconfig
config BR2_PACKAGE_PYTHON_YAPPI
	bool "python-yappi"
	select BR2_PACKAGE_PYTHON_SIX # runtime
```
